/**
 * @cliArgs --device "F28004x" --package "F28004x_100PZ" --part "F28004x_100PZ" --product "powerSUITE@3.00.00.00"
 * @versions {"data":"2021010520","timestamp":"2021010520","tool":"1.7.0+1746","templates":null}
 */

/**
 * Import the modules used in this configuration.
 */
const TIDM_02000 = scripting.addModule("/devkits/TIDM_02000/TIDM_02000");

/**
 * Write custom configuration values to the imported modules.
 */
TIDM_02000.Fsw_Fctrl_Ratio            = 1;
TIDM_02000.SR_Deadband                = 0.1;
TIDM_02000.Vout                       = 12;
TIDM_02000.Vin                        = 400;
TIDM_02000.Vinmax                     = 420;
TIDM_02000.Vinmin                     = 370;
TIDM_02000.P_Rated                    = 300;
TIDM_02000.Pout                       = 300;
TIDM_02000.L2                         = 39;
TIDM_02000.L1                         = 4.7;
TIDM_02000.Co                         = 3000;
TIDM_02000.Vout_SenseMax              = 16.03;
TIDM_02000.Vin_SenseMax               = 673.61;
TIDM_02000.I_HVSenseMax               = 6.78;
TIDM_02000.I_LVSenseMax               = 71.99;
TIDM_02000.V_TripLevel                = 14;
TIDM_02000.I_TripLevel                = 4;
TIDM_02000.Rfltr                      = 1000;
TIDM_02000.Cfltr                      = 0.00033;
TIDM_02000.SR_mode                    = 1;
TIDM_02000.Fsw                        = 100;
TIDM_02000.Active_to_Passive_Deadband = 0.2;
TIDM_02000.Passive_to_Active_Deadband = 0.2;
